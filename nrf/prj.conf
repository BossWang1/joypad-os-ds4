## CMakeLists.txt
```
# Zephyr app CMakeLists for Joypad bt2usb on Seeed XIAO nRF52840 (xiao_ble)
#
# Compiles shared sources from ../src/ alongside nRF-specific code.
# BTstack from pico-sdk submodule (Zephyr HCI transport), TinyUSB device-only (nRF5x DCD).

cmake_minimum_required(VERSION 3.20)
find_package(Zephyr REQUIRED HINTS $ENV{ZEPHYR_BASE})
project(joypad_bt2usb)

set(SHARED_SRC "${CMAKE_CURRENT_LIST_DIR}/../src")
set(BTSTACK_PATH "${SHARED_SRC}/lib/pico-sdk/lib/btstack")
set(TINYUSB_PATH "${SHARED_SRC}/lib/tinyusb")

# ============================================================================
# Source files
# ============================================================================

set(SRCS
    # --- nRF-specific ---
    "src/main.c"
    "src/flash_nrf.c"
    "src/ws2812_nrf.c"
    "src/button_nrf.c"
    "src/btstack_tlv_nrf.c"
    "${SHARED_SRC}/platform/nrf/platform_nrf.c"

    # --- App ---
    "${SHARED_SRC}/apps/bt2usb/app.c"

    # --- Core services ---
    "${SHARED_SRC}/core/router/router.c"
    "${SHARED_SRC}/core/services/leds/leds.c"
    "${SHARED_SRC}/core/services/storage/storage.c"
    "${SHARED_SRC}/core/services/codes/codes.c"
    "${SHARED_SRC}/core/services/hotkeys/hotkeys.c"
    "${SHARED_SRC}/core/services/players/manager.c"
    "${SHARED_SRC}/core/services/players/feedback.c"
    "${SHARED_SRC}/core/services/profiles/profile.c"
    "${SHARED_SRC}/core/services/profiles/profile_indicator.c"

    # --- USB Device ---
    "${SHARED_SRC}/usb/usbd/usbd.c"
    "${SHARED_SRC}/usb/usbd/modes/hid_mode.c"
    "${SHARED_SRC}/usb/usbd/modes/sinput_mode.c"
    "${SHARED_SRC}/usb/usbd/modes/xinput_mode.c"
    "${SHARED_SRC}/usb/usbd/modes/switch_mode.c"
    "${SHARED_SRC}/usb/usbd/modes/ps3_mode.c"
    "${SHARED_SRC}/usb/usbd/modes/psclassic_mode.c"
    "${SHARED_SRC}/usb/usbd/modes/pcemini_mode.c"
    "${SHARED_SRC}/usb/usbd/modes/ps4_mode.c"
    "${SHARED_SRC}/usb/usbd/modes/xid_mode.c"
    "${SHARED_SRC}/usb/usbd/modes/xbone_mode.c"
    "${SHARED_SRC}/usb/usbd/modes/xac_mode.c"
    "${SHARED_SRC}/usb/usbd/modes/kbmouse_mode.c"
    "${SHARED_SRC}/usb/usbd/modes/gc_adapter_mode.c"
    "${SHARED_SRC}/usb/usbd/cdc/cdc.c"
    "${SHARED_SRC}/usb/usbd/cdc/cdc_protocol.c"
    "${SHARED_SRC}/usb/usbd/cdc/cdc_commands.c"
    "${SHARED_SRC}/usb/usbd/drivers/tud_xid.c"
    "${SHARED_SRC}/usb/usbd/drivers/tud_xinput.c"
    "${SHARED_SRC}/usb/usbd/drivers/tud_xbone.c"
    "${SHARED_SRC}/usb/usbd/drivers/xgip_protocol.c"
    "${SHARED_SRC}/usb/usbd/kbmouse/kbmouse.c"
    "${SHARED_SRC}/lib/libxsm3/xsm3.c"
    "${SHARED_SRC}/lib/libxsm3/usbdsec.c"
    "${SHARED_SRC}/lib/libxsm3/excrypt_des.c"
    "${SHARED_SRC}/lib/libxsm3/excrypt_parve.c"
    "${SHARED_SRC}/lib/libxsm3/excrypt_sha.c"

    # --- HID parser (shared with USB path) ---
    "${SHARED_SRC}/usb/usbh/hid/devices/generic/hid_parser.c"

    # --- BT HID device drivers ---
    "${SHARED_SRC}/bt/bthid/bthid.c"
    "${SHARED_SRC}/bt/bthid/bthid_registry.c"
    "${SHARED_SRC}/bt/bthid/devices/generic/bthid_gamepad.c"
    "${SHARED_SRC}/bt/bthid/devices/vendors/sony/ds3_bt.c"
    "${SHARED_SRC}/bt/bthid/devices/vendors/sony/ds4_bt.c"
    "${SHARED_SRC}/bt/bthid/devices/vendors/sony/ds5_bt.c"
    "${SHARED_SRC}/bt/bthid/devices/vendors/nintendo/switch_pro_bt.c"
    "${SHARED_SRC}/bt/bthid/devices/vendors/nintendo/switch2_ble.c"
    "${SHARED_SRC}/bt/bthid/devices/vendors/nintendo/wii_u_pro_bt.c"
    "${SHARED_SRC}/bt/bthid/devices/vendors/nintendo/wiimote_bt.c"
    "${SHARED_SRC}/bt/bthid/devices/vendors/microsoft/xbox_bt.c"
    "${SHARED_SRC}/bt/bthid/devices/vendors/microsoft/xbox_ble.c"
    "${SHARED_SRC}/bt/bthid/devices/vendors/google/stadia_bt.c"

    # --- BTstack host + transport ---
    "${SHARED_SRC}/bt/btstack/btstack_host.c"
    "${SHARED_SRC}/bt/btstack/bt_device_db.c"
    "${SHARED_SRC}/bt/transport/bt_transport.c"
    "${SHARED_SRC}/bt/transport/bt_transport_nrf.c"

    # --- BTstack core ---
    "${BTSTACK_PATH}/src/btstack_linked_list.c"
    "${BTSTACK_PATH}/src/btstack_memory.c"
    "${BTSTACK_PATH}/src/btstack_memory_pool.c"
    "${BTSTACK_PATH}/src/btstack_run_loop.c"
    "${BTSTACK_PATH}/src/btstack_run_loop_base.c"
    "${BTSTACK_PATH}/src/btstack_util.c"
    "${BTSTACK_PATH}/src/btstack_tlv.c"
    "${BTSTACK_PATH}/src/btstack_tlv_none.c"
    "${BTSTACK_PATH}/src/btstack_crypto.c"
    "${BTSTACK_PATH}/src/btstack_ring_buffer.c"
    "${BTSTACK_PATH}/src/hci.c"
    "${BTSTACK_PATH}/src/hci_cmd.c"
    "${BTSTACK_PATH}/src/hci_dump.c"
    "${BTSTACK_PATH}/src/hci_event.c"
    "${BTSTACK_PATH}/src/hci_event_builder.c"
    "${BTSTACK_PATH}/src/l2cap.c"
    "${BTSTACK_PATH}/src/l2cap_signaling.c"
    "${BTSTACK_PATH}/src/ad_parser.c"

    # --- BTstack BLE ---
    "${BTSTACK_PATH}/src/ble/sm.c"
    "${BTSTACK_PATH}/src/ble/att_dispatch.c"
    "${BTSTACK_PATH}/src/ble/att_db.c"
    "${BTSTACK_PATH}/src/ble/gatt_client.c"
    "${BTSTACK_PATH}/src/ble/gatt_service_client.c"
    "${BTSTACK_PATH}/src/ble/le_device_db_memory.c"
    "${BTSTACK_PATH}/src/ble/le_device_db_tlv.c"
    "${BTSTACK_PATH}/src/ble/gatt-service/hids_client.c"
    "${BTSTACK_PATH}/src/ble/gatt-service/device_information_service_client.c"
    "${BTSTACK_PATH}/src/ble/gatt-service/battery_service_client.c"

    # --- BTstack Classic (compiles but dead code on XIAO nRF52840 BLE-only) ---
    "${BTSTACK_PATH}/src/classic/sdp_client.c"
    "${BTSTACK_PATH}/src/classic/sdp_server.c"
    "${BTSTACK_PATH}/src/classic/sdp_util.c"
    "${BTSTACK_PATH}/src/classic/device_id_server.c"
    "${BTSTACK_PATH}/src/classic/hid_host.c"
    "${BTSTACK_PATH}/src/classic/btstack_link_key_db_memory.c"
    "${BTSTACK_PATH}/src/classic/btstack_link_key_db_tlv.c"

    # --- BTstack 3rd-party ---
    "${BTSTACK_PATH}/3rd-party/micro-ecc/uECC.c"
    "${BTSTACK_PATH}/3rd-party/rijndael/rijndael.c"

    # --- BTstack platform: embedded + Zephyr chipset ---
    "${BTSTACK_PATH}/platform/embedded/hci_dump_embedded_stdout.c"
    "${BTSTACK_PATH}/chipset/zephyr/btstack_chipset_zephyr.c"

    # --- TinyUSB device stack ---
    "${TINYUSB_PATH}/src/tusb.c"
    "${TINYUSB_PATH}/src/common/tusb_fifo.c"
    "${TINYUSB_PATH}/src/device/usbd.c"
    "${TINYUSB_PATH}/src/device/usbd_control.c"
    "${TINYUSB_PATH}/src/class/cdc/cdc_device.c"
    "${TINYUSB_PATH}/src/class/hid/hid_device.c"
    "${TINYUSB_PATH}/src/portable/nordic/nrf5x/dcd_nrf5x.c"
)

set(INCLUDE_DIRS
    "src"
    "${SHARED_SRC}"
    "${SHARED_SRC}/apps/bt2usb"
    "${SHARED_SRC}/usb/usbd"
    "${SHARED_SRC}/bt"
    "${SHARED_SRC}/bt/btstack"
    "${SHARED_SRC}/bt/bthid"
    "${SHARED_SRC}/lib/libxsm3"
    # BTstack includes
    "${BTSTACK_PATH}/src"
    "${BTSTACK_PATH}/src/ble"
    "${BTSTACK_PATH}/platform/embedded"
    "${BTSTACK_PATH}/3rd-party/micro-ecc"
    "${BTSTACK_PATH}/3rd-party/rijndael"
    "${BTSTACK_PATH}/chipset/zephyr"
    # TinyUSB
    "${TINYUSB_PATH}/src"
)

# ============================================================================
# Register sources with Zephyr build
# ============================================================================

target_sources(app PRIVATE ${SRCS})
target_include_directories(app PRIVATE ${INCLUDE_DIRS})

# ============================================================================
# Compile definitions
# ============================================================================

target_compile_definitions(app PRIVATE
    CONFIG_BT2USB=1
    CONFIG_USB=1
    DISABLE_USB_HOST=1
    BTSTACK_USE_NRF=1
    ENABLE_BTSTACK=1
    PLATFORM_NRF=1
    CONFIG_NO_NEOPIXEL=1
    # Use nRF-specific TinyUSB config instead of src/tusb_config.h
    CFG_TUSB_CONFIG_FILE="tusb_config_nrf.h"
)

# ============================================================================
# Version and build info
# ============================================================================

if(EXISTS "${CMAKE_CURRENT_LIST_DIR}/../VERSION")
    file(READ "${CMAKE_CURRENT_LIST_DIR}/../VERSION" JOYPAD_VERSION)
    string(STRIP "${JOYPAD_VERSION}" JOYPAD_VERSION)
else()
    set(JOYPAD_VERSION "0.0.0")
endif()

execute_process(
    COMMAND git rev-parse --short HEAD
    WORKING_DIRECTORY ${CMAKE_CURRENT_SOURCE_DIR}
    OUTPUT_VARIABLE GIT_COMMIT
    OUTPUT_STRIP_TRAILING_WHITESPACE
    ERROR_QUIET
)
if(NOT GIT_COMMIT)
    set(GIT_COMMIT "unknown")
endif()

string(TIMESTAMP BUILD_TIME "%Y-%m-%d %H:%M:%S")

target_compile_definitions(app PRIVATE
    JOYPAD_VERSION="${JOYPAD_VERSION}"
    GIT_COMMIT="${GIT_COMMIT}"
    BUILD_TIME="${BUILD_TIME}"
    BOARD_NAME="xiao_ble"
)

# Disable -Werror for cross-compiled shared code
target_compile_options(app PRIVATE -Wno-error)
```

## prj.conf
```kconfig
# Joypad bt2usb — nRF52840 Kconfig
#
# BTstack is the BLE host (via raw HCI), TinyUSB is the USB device stack.
# Zephyr provides: kernel, BLE controller (link layer), GPIO, NVS, clock.

# ============================================================================
# BLE Controller (raw HCI passthrough — BTstack is the host)
# ============================================================================
CONFIG_BT=y
CONFIG_BT_HCI_RAW=y
CONFIG_BT_CTLR_ASSERT_HANDLER=y
CONFIG_BT_BUF_ACL_RX_SIZE=255
CONFIG_BT_BUF_ACL_TX_SIZE=251
CONFIG_BT_BUF_CMD_TX_SIZE=255
CONFIG_BT_BUF_EVT_DISCARDABLE_SIZE=255
CONFIG_BT_CTLR_PRIVACY=n

# SoftDevice Controller needs these to compile in scanning + connection support.
# Without them, HCI LE scan/connect commands are rejected by the controller.
CONFIG_BT_OBSERVER=y
CONFIG_BT_CENTRAL=y
CONFIG_BT_MAX_CONN=2

# BTstack sends HCI commands with K_NO_WAIT; default count (2) causes drops.
CONFIG_BT_BUF_CMD_TX_COUNT=10

# ============================================================================
# USB — disabled (TinyUSB drives nRF52840 USBD hardware directly)
# ============================================================================
CONFIG_USB_DEVICE_STACK=n

# ============================================================================
# GPIO, Flash, NVS, Entropy
# ============================================================================
CONFIG_GPIO=y
CONFIG_ENTROPY_GENERATOR=y
CONFIG_HWINFO=y
CONFIG_REBOOT=y
CONFIG_FLASH=y
CONFIG_FLASH_MAP=y
CONFIG_FLASH_PAGE_LAYOUT=y
CONFIG_NVS=y

# ============================================================================
# C library
# ============================================================================
CONFIG_NEWLIB_LIBC=y

# ============================================================================
# Console — UART (RTT requires debug probe; TinyUSB owns USB, not Zephyr)
# ============================================================================
CONFIG_CONSOLE=y
CONFIG_SERIAL=y
CONFIG_UART_CONSOLE=y

# ============================================================================
# Stack / memory
# ============================================================================
CONFIG_MAIN_STACK_SIZE=4096
CONFIG_SYSTEM_WORKQUEUE_STACK_SIZE=2048
CONFIG_HEAP_MEM_POOL_SIZE=16384
CONFIG_BT_RX_STACK_SIZE=1024
CONFIG_BT_HCI_TX_STACK_SIZE_WITH_PROMPT=y
CONFIG_BT_HCI_TX_STACK_SIZE=640
CONFIG_ISR_STACK_SIZE=2048
CONFIG_IDLE_STACK_SIZE=256

# ============================================================================
# Build output
# ============================================================================
CONFIG_BUILD_OUTPUT_UF2=y
CONFIG_SIZE_OPTIMIZATIONS=y

# ============================================================================
# Disable unused subsystems
# ============================================================================
CONFIG_I2C=n
CONFIG_SPI=n
CONFIG_WATCHDOG=n
CONFIG_PM=n
CONFIG_BOOT_BANNER=n
CONFIG_BOOT_DELAY=0
CONFIG_ARM_MPU=y
CONFIG_MPU_STACK_GUARD=y
CONFIG_DYNAMIC_INTERRUPTS=y
CONFIG_IRQ_OFFLOAD=n

# ============================================================================
# Fault reporting — get register dump + stack trace on hard fault
# ============================================================================
CONFIG_FAULT_DUMP=2
```

## boards/xiao_ble.conf
```kconfig
# Seeed XIAO nRF52840 board-specific config
# DCDC is configured via devicetree in the board definition (xiao_ble_common.dtsi)
```

## boards/xiao_ble.overlay
```dts
/* Joypad bt2usb — Seeed XIAO nRF52840 devicetree overlay
 *
 * TinyUSB drives USB hardware directly, so disable Zephyr's USBD node.
 * Console redirected to UART0 (RTT is the actual debug output).
 */

&usbd {
	status = "disabled";
};

/ {
	chosen {
		zephyr,console = &uart0;
		zephyr,shell-uart = &uart0;
	};
};
```

## src/main.c
```c
// main.c - Seeed XIAO nRF52840 bt2usb entry point
//
// Zephyr entry point for the bt2usb app on Seeed XIAO nRF52840 (xiao_ble).
// BTstack runs in its own Zephyr thread (created by bt_transport_nrf.c).
// Main thread handles USB device, app logic, LED, and storage.

#include <stdio.h>
#include <string.h>

#include <zephyr/kernel.h>
#include <zephyr/irq.h>
#include <zephyr/sys/onoff.h>
#include <zephyr/fatal.h>
#include <zephyr/drivers/clock_control/nrf_clock_control.h>
#include <nrfx.h>

#include "tusb.h"
#include "platform/platform.h"
#include "core/input_interface.h"
#include "core/output_interface.h"
#include "core/services/players/manager.h"
#include "core/services/leds/leds.h"
#include "core/services/storage/storage.h"

// App layer
extern void app_init(void);
extern void app_task(void);
extern const OutputInterface** app_get_output_interfaces(uint8_t* count);
extern const InputInterface** app_get_input_interfaces(uint8_t* count);

static const OutputInterface** outputs = NULL;
static uint8_t output_count = 0;
static const InputInterface** inputs = NULL;
static uint8_t input_count = 0;
const OutputInterface* active_output = NULL;

// ============================================================================
// FAULT HANDLER — Zephyr's fault dump goes to UART console automatically.
// We just turn on blue LED as visual indicator and halt.
// ============================================================================
#define FAULT_LED_PIN 6  // Blue LED on XIAO BLE, active low

void k_sys_fatal_error_handler(unsigned int reason, const struct arch_esf *esf)
{
    (void)reason; (void)esf;
    NRF_P0->DIRSET = (1U << FAULT_LED_PIN);
    NRF_P0->OUTCLR = (1U << FAULT_LED_PIN);  // LED on
    for (;;) { __WFI(); }
}

// ============================================================================
// BT CONTROLLER ASSERT HANDLER
// ============================================================================

void bt_ctlr_assert_handle(char *file, uint32_t line)
{
    printf("[BT] Controller assert: %s:%u\n", file, (unsigned)line);
}

// ============================================================================
// USB POWER + IRQ SETUP
// ============================================================================

// TinyUSB's dcd_nrf5x.c requires tusb_hal_nrf_power_event() to be called
// with VBUS power events to start the USB peripheral.

extern void dcd_int_handler(uint8_t rhport);
extern void tusb_hal_nrf_power_event(uint32_t event);

// USBD interrupt handler
static void usbd_isr(const void *arg)
{
    (void)arg;
    dcd_int_handler(0);
}

// HFCLK must stay running for USB to work. MPSL (BLE radio stack) manages
// HFCLK and will stop it when the radio is idle, breaking USB. We request
// HFCLK through Zephyr's onoff manager so MPSL keeps it running.
static struct onoff_client hfclk_cli;

static void usb_hfclk_request(void)
{
    struct onoff_manager *mgr =
        z_nrf_clock_control_get_onoff(CLOCK_CONTROL_NRF_SUBSYS_HF);
    sys_notify_init_spinwait(&hfclk_cli.notify);
    int err = onoff_request(mgr, &hfclk_cli);
    if (err < 0) {
        printf("[usb] HFCLK request failed: %d\n", err);
        return;
    }
    // Wait for HFCLK to stabilize
    int res;
    while (sys_notify_fetch_result(&hfclk_cli.notify, &res) == -EAGAIN) {
        k_yield();
    }
    printf("[usb] HFCLK running\n");
}

// Call after tusb_init() to trigger USB enumeration.
// Uses dynamic interrupt registration and unconditionally fires power
// events (bt2usb is always USB-powered, so VBUS is always present).
static void usb_power_init(void)
{
    // Request HFCLK through Zephyr's clock manager (keeps MPSL aware)
    usb_hfclk_request();

    // Register USBD ISR dynamically (runtime, not via static ISR table)
    irq_connect_dynamic(USBD_IRQn, 2, usbd_isr, NULL, 0);

    // Reset USBD to clean state (bootloader may have left it active)
    if (NRF_USBD->ENABLE) {
        NRF_USBD->USBPULLUP = 0;
        __ISB(); __DSB();
        NVIC_DisableIRQ(USBD_IRQn);
        NRF_USBD->INTENCLR = NRF_USBD->INTEN;
        NRF_USBD->ENABLE = 0;
        __ISB(); __DSB();
    }

    // Log USBREGSTATUS for debugging
    uint32_t usb_reg = NRF_POWER->USBREGSTATUS;
    printf("[usb] USBREGSTATUS=0x%08x VBUS=%d OUTRDY=%d\n",
           (unsigned)usb_reg,
           !!(usb_reg & POWER_USBREGSTATUS_VBUSDETECT_Msk),
           !!(usb_reg & POWER_USBREGSTATUS_OUTPUTRDY_Msk));

    // Always fire both events — bt2usb is USB-powered so VBUS is present.
    // Don't gate on USBREGSTATUS since some boards may not report it.
    printf("[usb] Firing DETECTED event\n");
    tusb_hal_nrf_power_event(0);  // USB_EVT_DETECTED

    printf("[usb] Firing READY event\n");
    tusb_hal_nrf_power_event(2);  // USB_EVT_READY

    // Belt and suspenders: ensure USBD IRQ is enabled
    irq_enable(USBD_IRQn);

    printf("[usb] USBD init complete, pullup=%d\n",
           !!(NRF_USBD->USBPULLUP));
}

// ============================================================================
// MAIN
// ============================================================================

int main(void)
{
    printf("[joypad] Starting bt2usb on Seeed XIAO nRF52840...\n");

    // Initialize shared services
    leds_init();
    storage_init();
    players_init();
    app_init();

    // Get and initialize input interfaces
    inputs = app_get_input_interfaces(&input_count);
    for (uint8_t i = 0; i < input_count; i++) {
        if (inputs[i] && inputs[i]->init) {
            printf("[joypad] Initializing input: %s\n", inputs[i]->name);
            inputs[i]->init();
        }
    }

    // Get and initialize output interfaces
    outputs = app_get_output_interfaces(&output_count);
    if (output_count > 0 && outputs[0]) {
        active_output = outputs[0];
    }
    for (uint8_t i = 0; i < output_count; i++) {
        if (outputs[i] && outputs[i]->init) {
            printf("[joypad] Initializing output: %s\n", outputs[i]->name);
            outputs[i]->init();
        }
    }

    printf("[joypad] tusb_inited=%d\n", tud_inited());

    // Trigger USB enumeration (handles VBUS already present at boot)
    usb_power_init();

    printf("[joypad] Entering main loop\n");

    // Main loop
    while (1) {
        // Poll TinyUSB (non-blocking)
        tud_task_ext(0, false);

        leds_task();
        players_task();
        storage_task();

        // Poll input interfaces
        for (uint8_t i = 0; i < input_count; i++) {
            if (inputs[i] && inputs[i]->task) {
                inputs[i]->task();
            }
        }

        // Run output interface tasks
        for (uint8_t i = 0; i < output_count; i++) {
            if (outputs[i] && outputs[i]->task) {
                outputs[i]->task();
            }
        }

        app_task();

        // Yield to other Zephyr threads (BTstack runs in its own thread)
        k_msleep(1);
    }

    return 0;
}
```

## src/btstack_config.h
```c
// btstack_config.h - Seeed XIAO nRF52840 BTstack config wrapper
// Shadows src/bt/btstack/btstack_config.h (RP2040 version) in include path
#include "../../src/bt/btstack/btstack_config_nrf.h"
```

## src/btstack_tlv_nrf.c
```c
// btstack_tlv_nrf.c - BTstack TLV backed by Zephyr NVS
//
// Maps 32-bit BTstack TLV tags to 16-bit NVS IDs via XOR hash.
// Shares the NVS partition with flash_nrf.c (app settings use key 1;
// BTstack tags hash to 0x0600+ range, no collision).
//
// Zephyr NVS is internally mutex-protected, so this is safe to call
// from the BTstack thread while the main thread uses the same NVS.

#include "btstack_tlv_nrf.h"
#include <stdio.h>

static struct nvs_fs *tlv_nvs;

// Decode 4-char tag for debug printing
static void tag_to_str(uint32_t tag, char out[5])
{
    out[0] = (char)((tag >> 24) & 0xFF);
    out[1] = (char)((tag >> 16) & 0xFF);
    out[2] = (char)((tag >> 8) & 0xFF);
    out[3] = (char)(tag & 0xFF);
    out[4] = '\0';
    // Replace non-printable chars with '.'
    for (int i = 0; i < 4; i++) {
        if (out[i] < 0x20 || out[i] > 0x7E) out[i] = '.';
    }
}

// Hash 32-bit tag to 16-bit NVS ID.
// BTstack tags are 4-char codes like "BTD\x00" (0x42544400).
// XOR upper and lower 16 bits → unique IDs in 0x0600+ range.
static uint16_t tag_to_nvs_id(uint32_t tag)
{
    return (uint16_t)((tag >> 16) ^ (tag & 0xFFFF));
}

static int tlv_get_tag(void *context, uint32_t tag, uint8_t *buffer, uint32_t buffer_size)
{
    (void)context;
    if (!tlv_nvs) return 0;

    uint16_t id = tag_to_nvs_id(tag);
    ssize_t len = nvs_read(tlv_nvs, id, buffer, buffer_size);
    char ts[5];
    tag_to_str(tag, ts);
    if (len < 0) {
        printf("[TLV_NRF] get '%s' (nvs_id=0x%04x): not found\n", ts, id);
        return 0;
    }
    printf("[TLV_NRF] get '%s' (nvs_id=0x%04x): %zd bytes\n", ts, id, len);
    return (int)len;
}

static int tlv_store_tag(void *context, uint32_t tag, const uint8_t *data, uint32_t data_size)
{
    (void)context;
    if (!tlv_nvs) return -1;

    uint16_t id = tag_to_nvs_id(tag);
    ssize_t len = nvs_write(tlv_nvs, id, data, data_size);
    char ts[5];
    tag_to_str(tag, ts);
    if (len < 0) {
        printf("[TLV_NRF] store '%s' (nvs_id=0x%04x): FAILED %zd\n", ts, id, len);
        return -1;
    }
    // nvs_write returns 0 if data was identical (no write needed), or data_size on write
    printf("[TLV_NRF] store '%s' (nvs_id=0x%04x): %u bytes (nvs_ret=%zd)\n",
           ts, id, (unsigned)data_size, len);
    return 0;
}

static void tlv_delete_tag(void *context, uint32_t tag)
{
    (void)context;
    if (!tlv_nvs) return;

    uint16_t id = tag_to_nvs_id(tag);
    char ts[5];
    tag_to_str(tag, ts);
    printf("[TLV_NRF] delete '%s' (nvs_id=0x%04x)\n", ts, id);
    nvs_delete(tlv_nvs, id);
}

static const btstack_tlv_t btstack_tlv_nrf_impl = {
    .get_tag    = tlv_get_tag,
    .store_tag  = tlv_store_tag,
    .delete_tag = tlv_delete_tag,
};

const btstack_tlv_t * btstack_tlv_nrf_init(struct nvs_fs *nvs)
{
    tlv_nvs = nvs;
    printf("[TLV_NRF] Initialized with NVS\n");
    return &btstack_tlv_nrf_impl;
}
```

## src/btstack_tlv_nrf.h
```c
// btstack_tlv_nrf.h - BTstack TLV backed by Zephyr NVS
//
// Provides persistent key-value storage for BTstack (BLE bond keys,
// SM identity keys, etc.) using the nRF52840's internal flash via NVS.

#ifndef BTSTACK_TLV_NRF_H
#define BTSTACK_TLV_NRF_H

#include "btstack_tlv.h"
#include <zephyr/fs/nvs.h>

// Initialize NVS-backed TLV. Takes a mounted NVS filesystem handle
// (shared with flash_nrf.c). Returns the btstack_tlv_t implementation.
const btstack_tlv_t * btstack_tlv_nrf_init(struct nvs_fs *nvs);

#endif
```

## src/button_nrf.c
```c
// button_nrf.c - Button driver stub for Seeed XIAO nRF52840
//
// Seeed XIAO nRF52840 has no exposed user button. This stub satisfies the linker.

#include "core/services/button/button.h"
#include <stdio.h>

static button_callback_t button_cb = NULL;

void button_init(void)
{
    printf("[button_nrf] No user button on this board (stub)\n");
}

void button_set_callback(button_callback_t cb)
{
    button_cb = cb;
}

button_event_t button_task(void)
{
    // No button to poll
    return BUTTON_EVENT_NONE;
}
```

## src/flash_nrf.c
```c
// flash_nrf.c - NVS-based settings storage for Seeed XIAO nRF52840
//
// Implements flash.h API using Zephyr's NVS subsystem.
// Same flash_t struct, just stored in NVS instead of raw flash.

#include "core/services/storage/flash.h"
#include "platform/platform.h"
#include <stdio.h>
#include <string.h>

#include <zephyr/drivers/flash.h>
#include <zephyr/storage/flash_map.h>
#include <zephyr/fs/nvs.h>

// NVS configuration
#define NVS_PARTITION       storage_partition
#define NVS_PARTITION_ID    FIXED_PARTITION_ID(NVS_PARTITION)
#define NVS_SETTINGS_KEY    1
#define SETTINGS_MAGIC      0x47435052  // "GCPR"
#define SAVE_DEBOUNCE_MS    5000

static struct nvs_fs nvs;
static bool nvs_initialized = false;
static uint32_t last_change_ms = 0;
static bool save_pending = false;
static flash_t pending_settings;
static uint32_t current_sequence = 0;

// Runtime settings
static flash_t runtime_settings;
static bool runtime_settings_loaded = false;

struct nvs_fs* flash_nrf_get_nvs(void)
{
    return nvs_initialized ? &nvs : NULL;
}

void flash_init(void)
{
    save_pending = false;

    const struct flash_area *fa;
    int rc = flash_area_open(NVS_PARTITION_ID, &fa);
    if (rc) {
        printf("[flash_nrf] Failed to open storage partition: %d\n", rc);
        return;
    }

    nvs.flash_device = flash_area_get_device(fa);
    nvs.offset = fa->fa_off;
    nvs.sector_size = 4096;
    nvs.sector_count = fa->fa_size / nvs.sector_size;
    flash_area_close(fa);

    rc = nvs_mount(&nvs);
    if (rc) {
        printf("[flash_nrf] NVS mount failed: %d\n", rc);
        return;
    }

    nvs_initialized = true;
    printf("[flash_nrf] NVS initialized (%d sectors)\n", nvs.sector_count);

    // Try to load runtime settings
    if (flash_load(&runtime_settings)) {
        runtime_settings_loaded = true;
        current_sequence = runtime_settings.sequence;
    }
}

bool flash_load(flash_t* settings)
{
    if (!nvs_initialized) return false;

    ssize_t len = nvs_read(&nvs, NVS_SETTINGS_KEY, settings, sizeof(flash_t));
    if (len != sizeof(flash_t)) {
        printf("[flash_nrf] No saved settings (read %zd bytes)\n", len);
        return false;
    }

    if (settings->magic != SETTINGS_MAGIC) {
        printf("[flash_nrf] Invalid settings magic\n");
        return false;
    }

    printf("[flash_nrf] Settings loaded\n");
    return true;
}

void flash_save(const flash_t* settings)
{
    if (!nvs_initialized) return;

    memcpy(&pending_settings, settings, sizeof(flash_t));
    pending_settings.magic = SETTINGS_MAGIC;
    save_pending = true;
    last_change_ms = platform_time_ms();
}

void flash_save_now(const flash_t* settings)
{
    if (!nvs_initialized) return;

    static flash_t write_settings;
    memcpy(&write_settings, settings, sizeof(flash_t));
    write_settings.magic = SETTINGS_MAGIC;
    write_settings.sequence = ++current_sequence;

    ssize_t len = nvs_write(&nvs, NVS_SETTINGS_KEY, &write_settings, sizeof(flash_t));
    if (len < 0) {
        printf("[flash_nrf] NVS write failed: %zd\n", len);
        return;
    }

    printf("[flash_nrf] Saved to NVS (seq=%lu)\n", (unsigned long)write_settings.sequence);
    save_pending = false;
}

void flash_save_force(const flash_t* settings)
{
    flash_save_now(settings);
}

void flash_task(void)
{
    if (!save_pending) return;

    uint32_t now = platform_time_ms();
    if (now - last_change_ms >= SAVE_DEBOUNCE_MS) {
        flash_save_now(&pending_settings);
    }
}

void flash_on_bt_disconnect(void)
{
    // No-op on nRF52840
}

bool flash_has_pending_write(void)
{
    return save_pending;
}

// ============================================================================
// Custom Profile Helpers
// ============================================================================

void custom_profile_init(custom_profile_t* profile, const char* name)
{
    if (!profile) return;
    memset(profile, 0, sizeof(custom_profile_t));
    if (name) {
        strncpy(profile->name, name, CUSTOM_PROFILE_NAME_LEN - 1);
        profile->name[CUSTOM_PROFILE_NAME_LEN - 1] = '\0';
    }
    memset(profile->button_map, BUTTON_MAP_PASSTHROUGH, CUSTOM_PROFILE_BUTTON_COUNT);
    profile->left_stick_sens = 100;
    profile->right_stick_sens = 100;
    profile->flags = 0;
}

uint32_t custom_profile_apply_buttons(const custom_profile_t* profile, uint32_t buttons)
{
    if (!profile) return buttons;
    uint32_t output = 0;
    for (int i = 0; i < CUSTOM_PROFILE_BUTTON_COUNT; i++) {
        if (buttons & (1u << i)) {
            uint8_t mapping = profile->button_map[i];
            if (mapping == BUTTON_MAP_PASSTHROUGH) {
                output |= (1u << i);
            } else if (mapping == BUTTON_MAP_DISABLED) {
                // disabled
            } else if (mapping >= 1 && mapping <= CUSTOM_PROFILE_BUTTON_COUNT) {
                output |= (1u << (mapping - 1));
            }
        }
    }
    return output;
}

const custom_profile_t* flash_get_custom_profile(const flash_t* settings, uint8_t index)
{
    if (!settings) return NULL;
    if (index >= settings->custom_profile_count) return NULL;
    if (index >= CUSTOM_PROFILE_MAX_COUNT) return NULL;
    return &settings->profiles[index];
}

flash_t* flash_get_settings(void)
{
    if (!runtime_settings_loaded) return NULL;
    return &runtime_settings;
}

uint8_t flash_get_active_profile_index(void)
{
    if (!runtime_settings_loaded) return 0;
    return runtime_settings.active_profile_index;
}

void flash_set_active_profile_index(uint8_t index)
{
    if (!runtime_settings_loaded) return;
    runtime_settings.active_profile_index = index;
    flash_save(&runtime_settings);
}

uint8_t flash_get_total_profile_count(void)
{
    if (!runtime_settings_loaded) return 1;
    return 1 + runtime_settings.custom_profile_count;
}

const custom_profile_t* flash_get_active_custom_profile(void)
{
    if (!runtime_settings_loaded) return NULL;
    uint8_t index = runtime_settings.active_profile_index;
    if (index == 0) return NULL;
    return flash_get_custom_profile(&runtime_settings, index - 1);
}

void flash_cycle_profile_next(void)
{
    if (!runtime_settings_loaded) return;
    uint8_t total = flash_get_total_profile_count();
    if (total <= 1) return;
    uint8_t current = runtime_settings.active_profile_index;
    uint8_t next = (current + 1) % total;
    flash_set_active_profile_index(next);
}

void flash_cycle_profile_prev(void)
{
    if (!runtime_settings_loaded) return;
    uint8_t total = flash_get_total_profile_count();
    if (total <= 1) return;
    uint8_t current = runtime_settings.active_profile_index;
    uint8_t prev = (current == 0) ? (total - 1) : (current - 1);
    flash_set_active_profile_index(prev);
}
```

## src/tusb_config_nrf.h
```c
// tusb_config_nrf.h - TinyUSB configuration for Seeed XIAO nRF52840
//
// Device-only configuration for bt2usb on Seeed XIAO nRF52840.
// No USB host (BT input only), same HID/CDC config as ESP32.

#ifndef _TUSB_CONFIG_H_
#define _TUSB_CONFIG_H_

#ifdef __cplusplus
 extern "C" {
#endif

//--------------------------------------------------------------------
// COMMON CONFIGURATION
//--------------------------------------------------------------------

#define CFG_TUSB_MCU                OPT_MCU_NRF5X
#define CFG_TUSB_OS                 OPT_OS_NONE

#define CFG_TUSB_MEM_SECTION
#define CFG_TUSB_MEM_ALIGN          __attribute__((aligned(4)))

#ifndef CFG_TUSB_DEBUG
#define CFG_TUSB_DEBUG              0
#endif

//--------------------------------------------------------------------
// USB DEVICE CONFIGURATION
//--------------------------------------------------------------------

// Device-only mode (no USB host on nRF52840 bt2usb)
#define CFG_TUSB_RHPORT0_MODE       OPT_MODE_DEVICE

#define CFG_TUD_ENDPOINT0_SIZE      64

// Standard HID gamepad mode
#define CFG_TUD_HID                 4   // Up to 4 HID gamepads

// Xbox Original (XID) mode support
#define CFG_TUD_XID                 1
#define CFG_TUD_XID_EP_BUFSIZE      32

// Xbox 360 (XInput) mode support
#define CFG_TUD_XINPUT              1
#define CFG_TUD_XINPUT_EP_BUFSIZE   32

// GameCube Adapter mode support
#define CFG_TUD_GC_ADAPTER          1
#define CFG_TUD_GC_ADAPTER_EP_BUFSIZE 37

// CDC configuration: single data port
#define CFG_TUD_CDC                 1

#define CFG_TUD_MSC                 0
#define CFG_TUD_MIDI                0
#define CFG_TUD_VENDOR              0

// HID buffer sizes
#define CFG_TUD_HID_EP_BUFSIZE      64

// CDC buffer sizes
#define CFG_TUD_CDC_RX_BUFSIZE      256
#define CFG_TUD_CDC_TX_BUFSIZE      1024
#define CFG_TUD_CDC_EP_BUFSIZE      64

#ifdef __cplusplus
 }
#endif

#endif /* _TUSB_CONFIG_H_ */
```

## src/ws2812_nrf.c
```c
// ws2812_nrf.c - NeoPixel stub for Seeed XIAO nRF52840
//
// Seeed XIAO nRF52840 base board has no NeoPixel. This stub satisfies the linker.

#include <stdint.h>
#include <stdbool.h>
#include <stdio.h>

void neopixel_init(void)
{
    printf("[neopixel] nRF52840 stub initialized (no LED)\n");
}

void neopixel_task(int pat)
{
    (void)pat;
}

void neopixel_set_override_color(uint8_t r, uint8_t g, uint8_t b)
{
    (void)r; (void)g; (void)b;
}

void neopixel_indicate_profile(uint8_t profile_index)
{
    (void)profile_index;
}

bool neopixel_is_indicating(void)
{
    return false;
}
```
